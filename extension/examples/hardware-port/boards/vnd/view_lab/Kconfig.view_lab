## extension/examples/hardware-port/boards/vnd/view_lab/Kconfig.view_lab
```kconfig
# SPDX-License-Identifier: Apache-2.0

config BOARD_VIEW_LAB
	select SOC_VIEW_M3
```

## extension/examples/hardware-port/boards/vnd/view_lab/board.yml
```yaml
board:
  name: view_lab
  full_name: View Lab Cortex-M3 teaching board
  vendor: vnd
  socs:
    - name: view_m3
```

## extension/examples/hardware-port/soc/vnd/view_m3/Kconfig
```kconfig
# SPDX-License-Identifier: Apache-2.0

config SOC_VIEW_M3
	select ARM
	select CPU_CORTEX_M3
```

## extension/examples/hardware-port/soc/vnd/view_m3/Kconfig.defconfig
```kconfig
# SPDX-License-Identifier: Apache-2.0

if SOC_VIEW_M3

config NUM_IRQS
	default 32

endif
```

## extension/examples/hardware-port/soc/vnd/view_m3/Kconfig.soc
```kconfig
# SPDX-License-Identifier: Apache-2.0

config SOC_VIEW_M3
	bool

config SOC
	default "view_m3" if SOC_VIEW_M3
```

## extension/examples/onboarding/modules/greeting/Kconfig
```kconfig
# SPDX-License-Identifier: Apache-2.0
config ONBOARDING_GREETING
	bool "Greeting from the local onboarding module"
	help
	  Build the example greeting library and print its message at startup.
```
